## examples/espidf-arduino-platformio/sdkconfig.defaults
```kconfig
CONFIG_AUTOSTART_ARDUINO=y
# CONFIG_WS2812_LED_ENABLE is not set
CONFIG_FREERTOS_HZ=1000
CONFIG_MBEDTLS_PSK_MODES=y
CONFIG_MBEDTLS_KEY_EXCHANGE_PSK=y

CONFIG_FREERTOS_USE_TICKLESS_IDLE=y
CONFIG_PM_ENABLE=y
CONFIG_ESP_WIFI_ENHANCED_LIGHT_SLEEP=y

CONFIG_BOOTLOADER_COMPILER_OPTIMIZATION_SIZE=y
CONFIG_COMPILER_OPTIMIZATION_SIZE=y
CONFIG_ESP_CONSOLE_USB_SERIAL_JTAG=y
CONFIG_COMPILER_CXX_EXCEPTIONS=y
CONFIG_LOG_MAXIMUM_LEVEL=2
CONFIG_LOG_DEFAULT_LEVEL=2

CONFIG_PM_POWER_DOWN_CPU_IN_LIGHT_SLEEP=y
CONFIG_PM_SLP_IRAM_OPT=y
CONFIG_PM_RTOS_IDLE_OPT=y
CONFIG_ESP_WIFI_SLP_IRAM_OPT=y
CONFIG_PM_SLP_DISABLE_GPIO=n

CONFIG_PM_LIGHTSLEEP_RTC_OSC_CAL_INTERVAL=8
```
